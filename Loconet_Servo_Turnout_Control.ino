/****************************************************************************************  
 *   LocoNet Servo Turnout Control      (ATTINY85)    F.Miller 8/2018
 *         SKETCH TO CONTROL A LOCONET SWITCH SERVO ON ATTINY84
  ===========================================================================
  USES ONE FASCIA STRIP PB WITH TWO FASCIA STRIP LEDS.  NO RELAY FOR LEDS OR FROG POWER
  SERVO ROTATES CW (MAX) WHEN THROWN CMD, ROTATES CCW (MIN) WHEN CLOSED CMD
  RECEIVED LOCONET TURNOUT COMMAND (TO LNADDRESS) WILL ACTIVATE THE SERVO
  THE CMD IS GENERATED BY EXTERNAL LOCONET CMD (E.G. JMRI, THROTTLE) OR THE PB
  (WHICH GENERATES LOCONET CMD)  RED-LED  INDICATES THROWN (\) AND GRN-LED INDICATES CLOSED (/).
  ON POWER-UP, SERVO POSITIONS TO 'CLOSED'
    
  BY F.MILLER 11/24/17,  12/9/17 added PB debounce delay
  SW 101 - LEDs reversed on panel.  Thrown - Green normal, Closed - Amber
           Servo range increased by 5 on each end (max to 170, min to 140)
           5/22/18 - changed startup position to THROWN
           8/10/18 - fixed State on Startup, increased PB delay
  ==================================================================*/
#define LN_RX_PIN 3           // (3) PA7 CHIP PIN 6 ON ATTINY84
#define LN_TX_PIN 4           // (4) PA6 CHIP PIN 7 ON ATTINY84
#define servoPin 1            // (1) PB1 CHIP PIN 3 ON ATTINY84 
#define PB 5                  // (5) PA5 CHIP PIN 8 ON ATTINY84
#define R_LED 2               // (0) PB0 CHIP PIN 2 ON ATTINY84
#define A_LED 0               // (2) PB2 CHIP PIN 5 ON ATTINY84 
#define DEVICE_OFF 1          // aka CLOSED
#define DEVICE_ON 0           // aka THROWN

#include <LocoNet.h>          // support loconet messaging
lnMsg *LnPacket;
#include <SoftwareServo.h>
SoftwareServo myservo;        // create servo object to control a servo 
int lastPos;
//===================================================================
int LNAddress = 101;          // FIXED for this sketch     
//===================================================================
int pos = 0;                  // working Servo Position
int maxPos = 170;             // FIXED for this sketch            
int minPos = 140;             // FIXED for this sketch     
unsigned long previousMillis = 0;  // store last time LED was updated
unsigned long currentMillis;       // capture current time
unsigned long pbDly = 2000;        // 1 sec delay between button reads
boolean lastState = HIGH;
boolean svoMoving = false;
boolean firstTime = true;

void setup() {
  LocoNet.init(LN_TX_PIN);
  myservo.attach(servoPin);
  pinMode(R_LED,OUTPUT);
  pinMode(A_LED,OUTPUT);
  pinMode(PB,INPUT);
}

void loop()  {
    if (firstTime){                 //first time active, do a THROWN command
        firstTime = false;
        svoMoving = true;
        sendOPC_SW_REQ(LNAddress - 1, DEVICE_ON, 1);  //send cmd to THROWN
        lastState = LOW; 
    }
    currentMillis = millis();
    if(currentMillis - previousMillis >= pbDly) {  //check for PB delay
      if (digitalRead(PB)==LOW  && lastState !=LOW && !svoMoving) {
        svoMoving = true;
        sendOPC_SW_REQ(LNAddress - 1, DEVICE_ON, 1);   //send cmd to THROW
        lastState = LOW;
      }  
      if (digitalRead(PB)==LOW && lastState != HIGH && !svoMoving) {
        svoMoving = true;  
        sendOPC_SW_REQ(LNAddress - 1, DEVICE_OFF, 1);  //send cmd to CLOSE
        lastState = HIGH;
      }
      previousMillis = currentMillis;      // reset for next time around  
      }
  LnPacket = LocoNet.receive() ;           // Check for any received LocoNet packets
  if( LnPacket ) {
    if(!LocoNet.processSwitchSensorMessage(LnPacket)) {
      delay(1);                            // Apparently have to do something ?
    }
  }
}

/* ===================================================================================
                **** EXECUTE RECEIVED LOCONET SWITCH COMMAND  ****
===================================================================================*/

void notifySwitchRequest( uint16_t Address, uint8_t Output, uint8_t Direction )  {
   if (Address == LNAddress && Output != 0) {        //only respond to messages with OP=ON
        if (Direction == 0 && lastPos != maxPos) {   //THROWN
          svoMoving = true;
          for(pos = minPos; pos <= maxPos; pos += 1){  // goes from 0 degrees to current set degrees
            myservo.write(pos);                       // tell servo to go to position in variable 'pos' 
            SoftwareServo::refresh();                 // must call at least once every 50ms or so to keep your servos updating
            delay(15);                                // waits 15ms for the servo to reach the position 
          }
          digitalWrite(R_LED, HIGH);              //TURN RED LED ON
          digitalWrite(A_LED, LOW);               //TURN GRN LED OFF
          svoMoving = false;
          lastPos = pos;
      } 
      if (Direction != 0 && lastPos != minPos ){                       // CLOSED
           svoMoving = true;
           for(pos = maxPos; pos >= minPos; pos-=1){  // from current max degrees to 0 degrees 
             myservo.write(pos);                    // tell servo to go to position in variable 'pos' 
             SoftwareServo::refresh();
             delay(15);                            // waits 15ms for the servo to reach the position 
          }
          digitalWrite(R_LED, LOW);           //TURN RED LED OFF
          digitalWrite(A_LED, HIGH);          //TURN GRN LED ON  
          svoMoving = false;
          lastPos = pos;
      }
   }
}
/* ===================================================================================
                    **** SEND LOCONET SWITCH COMMAND  ****
===================================================================================*/
void sendOPC_SW_REQ(int address, byte dir, byte on) {
 lnMsg SendPacket ;
 int sw2 = 0x00;
 if (dir) sw2 |= B00100000;
 if (on) sw2 |= B00010000;
 sw2 |= (address >> 7) & 0x0F;
 SendPacket.data[ 0 ] = OPC_SW_REQ ;
 SendPacket.data[ 1 ] = address & 0x7F ;
 SendPacket.data[ 2 ] = sw2 ;
 LocoNet.send( &SendPacket );
}

//============================== END OF SKETCH ================================================
